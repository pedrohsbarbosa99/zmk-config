#include "stream_cheap.dtsi"

&kscan {
    col-gpios = <
        &gpio0 17 GPIO_ACTIVE_HIGH
        &gpio0 20 GPIO_ACTIVE_HIGH
        &gpio0 22 GPIO_ACTIVE_HIGH
        &gpio0 24 GPIO_ACTIVE_HIGH
    >;
};

/ {
    battery: battery {
        compatible = "zmk,battery-voltage-divider";

        io-channels = <&adc 2>;   /* P0.04 = AIN2 */
        output-ohms = <1000000>;
        full-ohms = <2000000>;
    };
};

&adc {
    status = "okay";
};
